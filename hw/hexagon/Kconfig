## hw/hexagon/Kconfig
```kconfig
config HEX_VIRT
    depends on DRAGON
    select VIRTIO_MMIO

config DRAGON
    bool
    imply PTIMER
    depends on TCG
    select L2VIC  # Vector PIC
    select PL011
```
